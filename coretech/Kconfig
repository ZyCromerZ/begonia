## coretech/Kconfig
```kconfig
config OPCHAIN
	default y
	bool "Oneplus CoreTech helper, used for opchain module"

config DEFRAG_HELPER
	default y
	bool "Oneplus CoreTech helper, used for defrag module"

config CRPL_HELPER
	default y
	bool "Oneplus CoreTech helper, used for crpl module"

config ADJ_CHAIN
	default y
	bool "Chain task adj for victim select"
	help
	 To chain task adj for any purpose

config HOUSTON
	default y
	bool "houston rocket play your temperature guard"
	help
	 Realtime temperature monitor
```
